#include "OLED.h"
#include <stdarg.h>
#include <stdio.h>
#include <string.h>

/* ==================== 8x16 ASCII 字体 (ASCII 32~126, 每个字符 16 字节) ==================== */
static const uint8_t OLED_Font8x16[][16] = {
    {0x00,0x00,0x00,0x00,0x00,0x00,0x00,0x00,0x00,0x00,0x00,0x00,0x00,0x00,0x00,0x00}, /* space */
    {0x00,0x00,0x00,0xF8,0x00,0x00,0x00,0x00,0x00,0x00,0x00,0x33,0x30,0x00,0x00,0x00}, /* ! */
    {0x00,0x10,0x0C,0x06,0x10,0x0C,0x06,0x00,0x00,0x00,0x00,0x00,0x00,0x00,0x00,0x00}, /* " */
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    {0x00,0x06,0x01,0x01,0x02,0x02,0x04,0x04,0x00,0x00,0x00,0x00,0x00,0x00,0x00,0x00}, /* ~ */
};

/* ==================== 全局变量 ==================== */
static I2C_HandleTypeDef *oled_i2c;
static uint8_t OLED_Buffer[OLED_WIDTH * OLED_PAGES];

/* ==================== 底层通信 ==================== */

static void OLED_WriteCmd(uint8_t cmd)
{
    uint8_t buf[2] = {0x00, cmd};
    HAL_I2C_Master_Transmit(oled_i2c, OLED_ADDR, buf, 2, 10);
}

static void OLED_WriteData(uint8_t dat)
{
    uint8_t buf[2] = {0x40, dat};
    HAL_I2C_Master_Transmit(oled_i2c, OLED_ADDR, buf, 2, 10);
}

/* ==================== 初始化 ==================== */

void OLED_Init(I2C_HandleTypeDef *hi2c)
{
    oled_i2c = hi2c;

    OLED_WriteCmd(0xAE); /* 关闭显示 */
    OLED_WriteCmd(0xD5); /* 设置显示时钟分频 */
    OLED_WriteCmd(0x80);
    OLED_WriteCmd(0xA8); /* 设置多路复用比 */
    OLED_WriteCmd(0x3F); /* 64 行 */
    OLED_WriteCmd(0xD3); /* 设置显示偏移 */
    OLED_WriteCmd(0x00);
    OLED_WriteCmd(0x40); /* 设置显示起始线 */
    OLED_WriteCmd(0x8D); /* 启用电荷泵 */
    OLED_WriteCmd(0x14);
    OLED_WriteCmd(0xA1); /* 段重映射 */
    OLED_WriteCmd(0xC8); /* COM 扫描方向 */
    OLED_WriteCmd(0xDA); /* 设置 COM 硬件引脚配置 */
    OLED_WriteCmd(0x12);
    OLED_WriteCmd(0x81); /* 设置对比度 */
    OLED_WriteCmd(0x7F);
    OLED_WriteCmd(0xD9); /* 设置预充电周期 */
    OLED_WriteCmd(0xF1);
    OLED_WriteCmd(0xDB); /* 设置 VCOMH 电压倍率 */
    OLED_WriteCmd(0x40);
    OLED_WriteCmd(0x20); /* 寻址模式 - 水平模式 */
    OLED_WriteCmd(0x00);
    OLED_WriteCmd(0xA4); /* 全局显示开启 (跟随 RAM) */
    OLED_WriteCmd(0xA6); /* 正常显示 */
    OLED_WriteCmd(0xAF); /* 开启显示 */

    OLED_Clear();
}

/* ==================== 显示控制 ==================== */

void OLED_Clear(void)
{
    memset(OLED_Buffer, 0x00, sizeof(OLED_Buffer));
    OLED_Display();
}

void OLED_Display(void)
{
    for (uint8_t page = 0; page < OLED_PAGES; page++)
    {
        OLED_WriteCmd(0xB0 + page);
        OLED_WriteCmd(0x00);
        OLED_WriteCmd(0x10);
        for (uint8_t col = 0; col < OLED_WIDTH; col++)
        {
            OLED_WriteData(OLED_Buffer[page * OLED_WIDTH + col]);
        }
    }
}

void OLED_SetContrast(uint8_t contrast)
{
    OLED_WriteCmd(0x81);
    OLED_WriteCmd(contrast);
}

/* ==================== 基础绘制 ==================== */

void OLED_DrawPoint(uint8_t x, uint8_t y)
{
    if (x >= OLED_WIDTH || y >= OLED_HEIGHT) return;
    uint8_t page = y / 8;
    uint8_t bit  = y % 8;
    OLED_Buffer[page * OLED_WIDTH + x] |= (1 << bit);
}

void OLED_ClearPoint(uint8_t x, uint8_t y)
{
    if (x >= OLED_WIDTH || y >= OLED_HEIGHT) return;
    uint8_t page = y / 8;
    uint8_t bit  = y % 8;
    OLED_Buffer[page * OLED_WIDTH + x] &= ~(1 << bit);
}

/* ==================== 字符/字符串显示 ==================== */

void OLED_ShowChar(uint8_t x, uint8_t y, char ch)
{
    if (x > OLED_WIDTH - 8 || y > OLED_HEIGHT - 16) return;
    if (ch < ' ' || ch > '~') ch = ' ';

    uint8_t idx = ch - ' ';
    for (uint8_t i = 0; i < 8; i++)
    {
        OLED_Buffer[(y / 8) * OLED_WIDTH + x + i] = OLED_Font8x16[idx][i];
        OLED_Buffer[(y / 8 + 1) * OLED_WIDTH + x + i] = OLED_Font8x16[idx][i + 8];
    }
}

void OLED_ShowString(uint8_t x, uint8_t y, const char *str)
{
    while (*str)
    {
        if (x > OLED_WIDTH - 8) { x = 0; y += 16; }
        if (y >= OLED_HEIGHT) break;
        OLED_ShowChar(x, y, *str);
        x += 8;
        str++;
    }
}

/* ==================== 数字显示 ==================== */

void OLED_ShowNum(uint8_t x, uint8_t y, uint32_t num, uint8_t len)
{
    char buf[11];
    for (uint8_t i = 0; i < len; i++) buf[i] = '0';
    buf[len] = '\0';

    uint8_t pos = len - 1;
    do {
        buf[pos--] = '0' + (num % 10);
        num /= 10;
    } while (num > 0 && pos < len);

    OLED_ShowString(x, y, buf);
}

void OLED_ShowSignedNum(uint8_t x, uint8_t y, int32_t num, uint8_t len)
{
    char buf[12];
    uint8_t i = 0;
    if (num < 0) { buf[i++] = '-'; num = -num; }
    for (; i <= len; i++) buf[i] = '0';
    buf[len + 1] = '\0';

    uint8_t pos = len;
    uint32_t unum = (uint32_t)(num >= 0 ? num : -num);
    do {
        buf[pos--] = '0' + (unum % 10);
        unum /= 10;
    } while (unum > 0);

    OLED_ShowString(x, y, buf);
}

void OLED_ShowFloat(uint8_t x, uint8_t y, float num, uint8_t intLen, uint8_t decLen)
{
    char buf[20];
    char fmt[10];
    sprintf(fmt, "%%%d.%df", intLen + decLen + 1, decLen);
    sprintf(buf, fmt, num);
    OLED_ShowString(x, y, buf);
}

void OLED_ShowHex(uint8_t x, uint8_t y, uint32_t num, uint8_t len)
{
    char buf[11] = "0x";
    for (uint8_t i = 0; i < len; i++) buf[2 + i] = '0';
    buf[2 + len] = '\0';

    uint8_t pos = 2 + len - 1;
    do {
        uint8_t d = num & 0x0F;
        buf[pos--] = (d < 10) ? ('0' + d) : ('A' + d - 10);
        num >>= 4;
    } while (num > 0 && pos >= 2);

    OLED_ShowString(x, y, buf);
}

void OLED_ShowBin(uint8_t x, uint8_t y, uint32_t num, uint8_t len)
{
    char buf[35] = "0b";
    for (uint8_t i = 0; i < len; i++) buf[2 + i] = '0';
    buf[2 + len] = '\0';

    uint8_t pos = 2 + len - 1;
    do {
        buf[pos--] = '0' + (num & 1);
        num >>= 1;
    } while (num > 0 && pos >= 2);

    OLED_ShowString(x, y, buf);
}

/* ==================== 几何图形 ==================== */

void OLED_DrawLine(uint8_t x0, uint8_t y0, uint8_t x1, uint8_t y1)
{
    int dx  = (int)x1 - (int)x0;
    int dy  = (int)y1 - (int)y0;
    int sx  = dx > 0 ? 1 : -1;
    int sy  = dy > 0 ? 1 : -1;
    int err;

    dx = dx > 0 ? dx : -dx;
    dy = dy > 0 ? dy : -dy;
    err = dx - dy;

    while (1)
    {
        OLED_DrawPoint(x0, y0);
        if (x0 == x1 && y0 == y1) break;
        int e2 = err * 2;
        if (e2 > -dy) { err -= dy; x0 += sx; }
        if (e2 <  dx) { err += dx; y0 += sy; }
    }
}

void OLED_DrawRect(uint8_t x, uint8_t y, uint8_t w, uint8_t h)
{
    OLED_DrawLine(x, y, x + w - 1, y);
    OLED_DrawLine(x, y + h - 1, x + w - 1, y + h - 1);
    OLED_DrawLine(x, y, x, y + h - 1);
    OLED_DrawLine(x + w - 1, y, x + w - 1, y + h - 1);
}

void OLED_FillRect(uint8_t x, uint8_t y, uint8_t w, uint8_t h)
{
    for (uint8_t col = x; col < x + w; col++)
        for (uint8_t row = y; row < y + h; row++)
            OLED_DrawPoint(col, row);
}

void OLED_DrawCircle(uint8_t cx, uint8_t cy, uint8_t r)
{
    int x = 0, y = r;
    int d = 3 - 2 * r;
    while (y >= x)
    {
        OLED_DrawPoint(cx + x, cy + y);
        OLED_DrawPoint(cx - x, cy + y);
        OLED_DrawPoint(cx + x, cy - y);
        OLED_DrawPoint(cx - x, cy - y);
        OLED_DrawPoint(cx + y, cy + x);
        OLED_DrawPoint(cx - y, cy + x);
        OLED_DrawPoint(cx + y, cy - x);
        OLED_DrawPoint(cx - y, cy - x);
        x++;
        if (d > 0) { y--; d = d + 4 * (x - y) + 10; }
        else       { d = d + 4 * x + 6; }
    }
}

/* ==================== 格式化输出 ==================== */

void OLED_Printf(uint8_t x, uint8_t y, const char *fmt, ...)
{
    char buf[64];
    va_list args;
    va_start(args, fmt);
    vsnprintf(buf, sizeof(buf), fmt, args);
    va_end(args);
    OLED_ShowString(x, y, buf);
}

/* ==================== 中文显示 (占位) ==================== */
__weak void OLED_ShowChinese(uint8_t x, uint8_t y, uint8_t n)
{
    (void)x; (void)y; (void)n;
}
